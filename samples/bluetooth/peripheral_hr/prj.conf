## prj.conf
```kconfig
CONFIG_BT=y
CONFIG_BT_DEBUG_LOG=y
CONFIG_BT_SMP=y
CONFIG_BT_PERIPHERAL=y
CONFIG_BT_GATT_CLIENT=y
CONFIG_BT_GATT_DIS=y
CONFIG_BT_GATT_DIS_PNP=n
CONFIG_BT_GATT_BAS=y
#CONFIG_BT_GATT_HRS=y
CONFIG_BT_DEVICE_NAME="* CTS *"
CONFIG_BT_DEVICE_APPEARANCE=833
CONFIG_BT_HCI_ACL_FLOW_CONTROL=n
```

## src/main.c
```c
#include <zephyr.h>
#include <zephyr/types.h>
#include <stddef.h>
#include <string.h>
#include <errno.h>
#include <sys/printk.h>
#include <sys/byteorder.h>
#include <bluetooth/bluetooth.h>
#include <bluetooth/hci.h>
#include <bluetooth/conn.h>
#include <bluetooth/uuid.h>
#include <bluetooth/gatt.h>
#include <bluetooth/services/bas.h>
#include <bluetooth/services/hrs.h>
#include "cts.h"

/**** **** **** **** Static Prototypes **** **** **** ****/

static u8_t notify_func(struct bt_conn *conn,
                        struct bt_gatt_subscribe_params *params,
                        const void *data, u16_t length);
static u8_t discover_cts_cb(struct bt_conn *conn,
                            const struct bt_gatt_attr *attr,
                            struct bt_gatt_discover_params *params);
static void connected_cb(struct bt_conn *conn, u8_t err);
static void disconnected_cb(struct bt_conn *conn, u8_t reason);
static void bt_ready(void);
static void auth_cancel(struct bt_conn *conn);
static void bas_notify(void);

/**** **** **** **** Local Variables **** **** **** ****/

struct bt_conn *default_conn;
static struct bt_uuid_16 uuid = BT_UUID_INIT_16(0);
static struct bt_gatt_discover_params discover_params;
static struct bt_gatt_subscribe_params subscribe_params;
static const struct bt_data ad[] = {
    BT_DATA_BYTES(BT_DATA_FLAGS,
                  (BT_LE_AD_GENERAL |
                   BT_LE_AD_NO_BREDR)),
    BT_DATA_BYTES(BT_DATA_UUID16_ALL,
                  0x0d, 0x18, 0x0f, 0x18, 0x0a, 0x18),
};
static struct bt_conn_cb conn_callbacks = {
    .connected = connected_cb,
    .disconnected = disconnected_cb,
};
static struct bt_conn_auth_cb auth_cb_display = {
    .cancel = auth_cancel,
};

/**** **** **** **** Peripheral API **** **** **** ****/

void main(void)
{
    int err;

    err = bt_enable(NULL);
    if (err) {
        printk("Bluetooth init failed (err %d)\n", err);
        return;
    }

    bt_ready();

    bt_conn_cb_register(&conn_callbacks);
    bt_conn_auth_cb_register(&auth_cb_display);

    /* Implement notification. At the moment there is no suitable way
     * of starting delayed work so we do it here
     */
    while (1) {
        k_sleep(K_SECONDS(1));

        /* Battery level simulation */
        bas_notify();

        /* Current Time Service updates only when time is changed */
        cts_notify();
    }
}

/**** **** **** **** Static Functions **** **** **** ****/

static u8_t notify_func(struct bt_conn *conn,
                        struct bt_gatt_subscribe_params *params,
                        const void *data, u16_t length)
{
    typedef struct MY_TIME_T {
        u8_t year_0;
        u8_t year_1;
	u8_t mon;  /* months starting from 1 */
	u8_t mday; /* day */
	u8_t hour; /* hours */
	u8_t min;  /* minutes */
	u8_t sec;  /* seconds */
	u8_t f256; /* fraction */
    } my_time_t;

    my_time_t * p_my_time = (my_time_t *) data;;

    if (!data)
    {
        printk("[UNSUBSCRIBED]\n");
        params->value_handle = 0U;
        return BT_GATT_ITER_STOP;
    }

    printk("[NOTIFICATION] leng: %u, ", length);
    printk("Time: %02u:", p_my_time->hour);
    printk("%02u:", p_my_time->min);
    printk("%02u\n", p_my_time->sec);
    return BT_GATT_ITER_CONTINUE;
}

static u8_t discover_cts_cb(struct bt_conn *conn,
                            const struct bt_gatt_attr *attr,
                            struct bt_gatt_discover_params *params)
{
    int err;

    if (!attr) {
        printk("Discover complete\n");
        (void)memset(params, 0, sizeof(*params));
        return BT_GATT_ITER_STOP;
    }

    printk("[CTS ATTRIBUTE] handle %u\n", attr->handle);

    if (!bt_uuid_cmp(discover_params.uuid, BT_UUID_CTS)) {
        printk("Discover BT_UUID_CTS\n");
        memcpy(&uuid, BT_UUID_CTS_CURRENT_TIME, sizeof(uuid));
        discover_params.uuid = &uuid.uuid;
        discover_params.start_handle = attr->handle + 1;
        discover_params.type = BT_GATT_DISCOVER_CHARACTERISTIC;

        err = bt_gatt_discover(conn, &discover_params);
        if (err) {
            printk("Discover failed (err %d)\n", err);
        }
    } else if (!bt_uuid_cmp(discover_params.uuid,
                            BT_UUID_CTS_CURRENT_TIME)) {
        memcpy(&uuid, BT_UUID_GATT_CCC, sizeof(uuid));
        discover_params.uuid = &uuid.uuid;
        discover_params.start_handle = attr->handle + 2;
        discover_params.type = BT_GATT_DISCOVER_DESCRIPTOR;
        subscribe_params.value_handle = bt_gatt_attr_value_handle(attr);

        err = bt_gatt_discover(conn, &discover_params);
        if (err) {
            printk("Discover failed (err %d)\n", err);
        }
    } else {
        subscribe_params.notify = notify_func;
        subscribe_params.value = BT_GATT_CCC_NOTIFY;
        subscribe_params.ccc_handle = attr->handle;

        err = bt_gatt_subscribe(conn, &subscribe_params);
        if (err && err != -EALREADY) {
            printk("Subscribe failed (err %d)\n", err);
        } else {
            printk("[SUBSCRIBED CTS]\n");
        }

        return BT_GATT_ITER_STOP;
    }

    return BT_GATT_ITER_STOP;
}

static void connected_cb(struct bt_conn *conn, u8_t err)
{
    if (err) {
        printk("Connection failed (err 0x%02x)\n", err);
    } else {
        default_conn = bt_conn_ref(conn);
        printk("Connected\n");

        memcpy(&uuid, BT_UUID_CTS, sizeof(uuid));
        discover_params.uuid = &uuid.uuid;
        discover_params.func = discover_cts_cb;
        discover_params.start_handle = 0x0001;
        discover_params.end_handle = 0xffff;
        discover_params.type = BT_GATT_DISCOVER_PRIMARY;
        err = bt_gatt_discover(default_conn, &discover_params);
        if (err) {
            printk("Discover failed(err %d)\n", err);
            return;
        }
    }
}

static void disconnected_cb(struct bt_conn *conn, u8_t reason)
{
    printk("Disconnected (reason 0x%02x)\n", reason);

    if (default_conn) {
        bt_conn_unref(default_conn);
        default_conn = NULL;
    }
}

static void bt_ready(void)
{
    int err;

    printk("Bluetooth initialized\n");

    cts_init();

    err = bt_le_adv_start(BT_LE_ADV_CONN_NAME, ad, ARRAY_SIZE(ad), NULL, 0);
    if (err) {
        printk("Advertising failed to start (err %d)\n", err);
        return;
    }

    printk("Advertising successfully started\n");
}

static void auth_cancel(struct bt_conn *conn)
{
    char addr[BT_ADDR_LE_STR_LEN];

    bt_addr_le_to_str(bt_conn_get_dst(conn), addr, sizeof(addr));

    printk("Pairing cancelled: %s\n", addr);
}

static void bas_notify(void)
{
    u8_t battery_level = bt_gatt_bas_get_battery_level();

    battery_level--;
    if (!battery_level)
    {
        battery_level = 100U;
    }
    bt_gatt_bas_set_battery_level(battery_level);
}
```

## src/cts.c
```c
#include <zephyr.h>
#include <zephyr/types.h>
#include <stddef.h>
#include <string.h>
#include <errno.h>
#include <sys/printk.h>
#include <sys/byteorder.h>
#include <bluetooth/bluetooth.h>
#include <bluetooth/hci.h>
#include <bluetooth/conn.h>
#include <bluetooth/uuid.h>
#include <bluetooth/gatt.h>
#include <sys/time.h>
#include <time.h>

/**** **** **** **** Static Prototypes **** **** **** ****/

static void ct_ccc_cfg_changed(const struct bt_gatt_attr *attr,
                               u16_t value);
static ssize_t read_ct(struct bt_conn *conn,
                       const struct bt_gatt_attr *attr,
		       void * buf,
                       u16_t  len,
                       u16_t  offset);
static ssize_t write_ct(struct bt_conn *conn,
                        const struct bt_gatt_attr *attr,
			const void *buf,
                        u16_t len,
                        u16_t offset,
			u8_t flags);
static void generate_current_time(u8_t *buf);
static ssize_t read_ct_local_info(struct bt_conn *conn,
                                  const struct bt_gatt_attr *attr,
                                  void * buf,
                                  u16_t  len,
                                  u16_t  offset);
static ssize_t write_ct_local_info(struct bt_conn *conn,
                        const struct bt_gatt_attr *attr,
			const void *buf,
                        u16_t len,
                        u16_t offset,
                                   u8_t flags);
static ssize_t read_ct_ref_info(struct bt_conn *conn,
                                const struct bt_gatt_attr *attr,
                                void * buf,
                                u16_t  len,
                                u16_t  offset);
static ssize_t write_ct_ref_info(struct bt_conn *conn,
                                 const struct bt_gatt_attr *attr,
                                 const void *buf,
                                 u16_t len,
                                 u16_t offset,
                                 u8_t flags);


static u8_t current_time[10];
static u8_t local_time_info[10];
static u8_t ref_time_info[10];
static u8_t ct_update;
struct timeval tv;
u8_t buf[10];

#define BT_UUID_CTS_LOCAL_TIME_INFORMATION BT_UUID_DECLARE_16(0x2a0f)
#define BT_UUID_CTS_REFERENCE_TIME_UPDATE BT_UUID_DECLARE_16(0x1806)

/* Current Time Service Declaration */
BT_GATT_SERVICE_DEFINE(
    cts_svc,
    BT_GATT_PRIMARY_SERVICE(BT_UUID_CTS),
    BT_GATT_CHARACTERISTIC(BT_UUID_CTS_CURRENT_TIME,
                           BT_GATT_CHRC_READ   |
                           BT_GATT_CHRC_NOTIFY |
                           BT_GATT_CHRC_WRITE,
                           BT_GATT_PERM_READ   |
                           BT_GATT_PERM_WRITE,
                           read_ct,
                           write_ct,
                           current_time),

    BT_GATT_CCC(ct_ccc_cfg_changed,
                BT_GATT_PERM_READ |
                BT_GATT_PERM_WRITE),

    BT_GATT_CHARACTERISTIC(BT_UUID_CTS_LOCAL_TIME_INFORMATION,
                           BT_GATT_CHRC_READ   |
                           BT_GATT_CHRC_WRITE,
                           BT_GATT_PERM_READ   |
                           BT_GATT_PERM_WRITE,
                           read_ct_local_info,
                           write_ct_local_info,
                           local_time_info),

    BT_GATT_CHARACTERISTIC(BT_UUID_CTS_REFERENCE_TIME_UPDATE,
                           BT_GATT_CHRC_WRITE_WITHOUT_RESP,
                           BT_GATT_PERM_WRITE,
                           read_ct_ref_info,
                           write_ct_ref_info,
                           ref_time_info)
    );

/**** **** **** **** Peripheral API **** **** **** ****/

void cts_init(void)
{
    /* Simulate current time for Current Time Service */
    generate_current_time(current_time);
}

void cts_notify(void)
{
    ct_update = 0U;
    generate_current_time(current_time);
    bt_gatt_notify(NULL, &cts_svc.attrs[1], &current_time, sizeof(current_time));
}

/**** **** **** **** Static Prototypes **** **** **** ****/

/* Obtain current time. */
static void ct_ccc_cfg_changed(const struct bt_gatt_attr *attr, u16_t value)
{
    /* TODO: Handle value */
}

static ssize_t read_ct(struct bt_conn *conn,
                       const struct bt_gatt_attr *attr,
		       void * buf,
                       u16_t  len,
                       u16_t  offset)
{
    const char *value = attr->user_data;

    return bt_gatt_attr_read(conn, attr, buf, len, offset, value,
                             sizeof(current_time));
}

static ssize_t write_ct(struct bt_conn *conn,
                        const struct bt_gatt_attr *attr,
			const void *buf,
                        u16_t len,
                        u16_t offset,
			u8_t flags)
{
    u8_t *value = attr->user_data;

    if (offset + len > sizeof(current_time)) {
        return BT_GATT_ERR(BT_ATT_ERR_INVALID_OFFSET);
    }

    memcpy(value + offset, buf, len);
    ct_update = 1U;

    return len;
}

static ssize_t read_ct_local_info(struct bt_conn *conn,
                                  const struct bt_gatt_attr *attr,
                                  void * buf,
                                  u16_t  len,
                                  u16_t  offset)
{
    const char *value = attr->user_data;

    return bt_gatt_attr_read(conn, attr, buf, len, offset, value,
                             sizeof(local_time_info));
}

static ssize_t write_ct_local_info(struct bt_conn *conn,
                        const struct bt_gatt_attr *attr,
			const void *buf,
                        u16_t len,
                        u16_t offset,
			u8_t flags)
{
    u8_t *value = attr->user_data;

    if (offset + len > sizeof(local_time_info)) {
        return BT_GATT_ERR(BT_ATT_ERR_INVALID_OFFSET);
    }

    memcpy(value + offset, buf, len);

    return len;
}

static ssize_t read_ct_ref_info(struct bt_conn *conn,
                                const struct bt_gatt_attr *attr,
                                void * buf,
                                u16_t  len,
                                u16_t  offset)
{
    const char *value = attr->user_data;

    return bt_gatt_attr_read(conn, attr, buf, len, offset, value,
                             sizeof(ref_time_info));
}

static ssize_t write_ct_ref_info(struct bt_conn *conn,
                                 const struct bt_gatt_attr *attr,
                                 const void *buf,
                                 u16_t len,
                                 u16_t offset,
                                 u8_t flags)
{
    u8_t *value = attr->user_data;

    if (offset + len > sizeof(ref_time_info)) {
        return BT_GATT_ERR(BT_ATT_ERR_INVALID_OFFSET);
    }

    memcpy(value + offset, buf, len);

    return len;
}

static void generate_current_time(u8_t *buf)
{
    u16_t year;
    struct tm *nowtm;

    /* 'Exact Time 256' contains 'Day Date Time' which contains
     * 'Date Time' - characteristic contains fields for:
     * year, month, day, hours, minutes and seconds.
     */

    int res = gettimeofday(&tv, NULL);

    if (res < 0) {
        printk("Error in gettimeofday(): %d\n", errno);
    }
    else
    {
        nowtm = localtime(&tv.tv_sec);
        printk ("Pphl: %02u:", nowtm->tm_hour);
        printk ("%02u:", nowtm->tm_min);
        printk ("%02u\n", nowtm->tm_sec);

        year = sys_cpu_to_le16(nowtm->tm_year + 1900);
        memcpy(buf,  &year, 2);      /* year */
        buf[2] = nowtm->tm_mon + 1;  /* months starting from 1 */
        buf[3] = nowtm->tm_mday;     /* day */
        buf[4] = nowtm->tm_hour;     /* hours */
        buf[5] = nowtm->tm_min;      /* minutes */
        buf[6] = nowtm->tm_sec;      /* seconds */
        buf[7] = 1U;                 /* day of week starting from 1 */
        buf[8] = 0U;                 /* 'Fractions 256 part of 'Exact Time 256' */
        buf[9] = 0U;                 /* Adjust reason */
    }
}
```

## src/cts.h
```c
#ifdef __cplusplus
extern "C" {
#endif

void cts_init(void);
void cts_notify(void);

#ifdef __cplusplus
}
#endif
```

## src/hrs.c
```c
/** @file
 *  @brief HRS Service sample
 */

/*
 * Copyright (c) 2016 Intel Corporation
 *
 * SPDX-License-Identifier: Apache-2.0
 */

#include <zephyr/types.h>
#include <stddef.h>
#include <string.h>
#include <errno.h>
#include <zephyr.h>
#include <init.h>

#include <bluetooth/bluetooth.h>
#include <bluetooth/hci.h>
#include <bluetooth/conn.h>
#include <bluetooth/uuid.h>
#include <bluetooth/gatt.h>

#define LOG_LEVEL CONFIG_BT_GATT_HRS_LOG_LEVEL
#include <logging/log.h>
LOG_MODULE_REGISTER(hrs);

static u8_t hrs_blsc;

static void hrmc_ccc_cfg_changed(const struct bt_gatt_attr *attr, u16_t value)
{
	ARG_UNUSED(attr);

	bool notif_enabled = (value == BT_GATT_CCC_NOTIFY);

	LOG_INF("HRS notifications %s", notif_enabled ? "enabled" : "disabled");
}

static ssize_t read_blsc(struct bt_conn *conn, const struct bt_gatt_attr *attr,
			 void *buf, u16_t len, u16_t offset)
{
	return bt_gatt_attr_read(conn, attr, buf, len, offset, &hrs_blsc,
				 sizeof(hrs_blsc));
}

/* Heart Rate Service Declaration */
BT_GATT_SERVICE_DEFINE(hrs_svc,
	BT_GATT_PRIMARY_SERVICE(BT_UUID_HRS),

                       BT_GATT_CHARACTERISTIC(BT_UUID_HRS_MEASUREMENT,
                                              BT_GATT_CHRC_NOTIFY,
                                              BT_GATT_PERM_NONE,
                                              NULL, NULL, NULL),
                       BT_GATT_CCC(hrmc_ccc_cfg_changed,
                                   BT_GATT_PERM_READ | BT_GATT_PERM_WRITE),

                       BT_GATT_CHARACTERISTIC(BT_UUID_HRS_BODY_SENSOR,
                                              BT_GATT_CHRC_READ,
                                              BT_GATT_PERM_READ,
                                              read_blsc, NULL, NULL),

                       BT_GATT_CHARACTERISTIC(BT_UUID_HRS_CONTROL_POINT,
                                              BT_GATT_CHRC_WRITE,
                                              BT_GATT_PERM_NONE,
                                              NULL, NULL, NULL),
);

static int hrs_init(struct device *dev)
{
	ARG_UNUSED(dev);

	hrs_blsc = 0x01;

	return 0;
}

int bt_gatt_hrs_notify(u16_t heartrate)
{
	int rc;
	static u8_t hrm[2];

	hrm[0] = 0x06; /* uint8, sensor contact */
	hrm[1] = heartrate;

	rc = bt_gatt_notify(NULL, &hrs_svc.attrs[1], &hrm, sizeof(hrm));

	return rc == -ENOTCONN ? 0 : rc;
}

SYS_INIT(hrs_init, APPLICATION, CONFIG_APPLICATION_INIT_PRIORITY);
```
